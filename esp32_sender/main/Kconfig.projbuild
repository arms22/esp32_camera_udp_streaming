## esp32_sender/main/Kconfig.projbuild
```kconfig
menu "Example Configuration"

    config M5STACK_UNITCAM
        bool "M5Stack UnitCam"
        default n

    config M5STACK_UNITCAM_S3
        bool "M5Stack UnitCam S3"
        default y

    config XIAO_ESP32S3_SENSE
        bool "Xiao ESP32S3 Sense"
        default n

    config ESP_WIFI_SSID
        string "WiFi SSID"
        default "myssid"
        help
            SSID (network name) for the example to connect to.

    config ESP_WIFI_PASSWORD
        string "WiFi Password"
        default "mypassword"
        help
            WiFi password (WPA or WPA2) for the example to use.

    config ESP_MAXIMUM_RETRY
        int "Maximum retry"
        default 5
        help
            Set the Maximum retry to avoid station reconnecting to the AP unlimited when the AP is really inexistent.
endmenu
```

## esp32_sender/sdkconfig.defaults
```kconfig
CONFIG_ESP32_DEFAULT_CPU_FREQ_240=y
CONFIG_ESP32S2_DEFAULT_CPU_FREQ_240=y
CONFIG_ESP32S3_DEFAULT_CPU_FREQ_240=y

CONFIG_ESPTOOLPY_FLASHSIZE_4MB=y
CONFIG_PARTITION_TABLE_OFFSET=0x10000

CONFIG_FREERTOS_HZ=1000
CONFIG_ESPTOOLPY_FLASHFREQ_80M=y
CONFIG_ESPTOOLPY_FLASHMODE_QIO=y

# CONFIG_SPIRAM_SUPPORT=y
# CONFIG_ESP32_SPIRAM_SUPPORT=y
# CONFIG_ESP32S2_SPIRAM_SUPPORT=y
# CONFIG_ESP32S3_SPIRAM_SUPPORT=y
# CONFIG_SPIRAM_SPEED_80M=y

CONFIG_CAMERA_TASK_STACK_SIZE=2560
CONFIG_ESP_WIFI_STATIC_RX_BUFFER_NUM=5
CONFIG_LWIP_MAX_ACTIVE_TCP=4
CONFIG_LWIP_MAX_LISTENING_TCP=4
```
